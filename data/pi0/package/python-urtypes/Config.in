## data/pi0/package/python-urtypes/Config.in
```kconfig
config BR2_PACKAGE_PYTHON_URTYPES
	bool "python-urtypes"
	help
      Python implementation of the Blockchain Commons UR Types specification 


	  https://github.com/jreesun/urtypes
    
```

## opt/external-packages/libraqm/Config.in
```kconfig
config BR2_PACKAGE_LIBRAQM
	bool "libraqm"
	select BR2_PACKAGE_FREETYPE
	select BR2_PACKAGE_HARFBUZZ
	select BR2_PACKAGE_LIBFRIBIDI
	help
	  A library for complex text layout that provides a convenient API 
	  for clients to perform complex text layout. Raqm can support 
	  OpenType fonts using HarfBuzz, bidirectional text using FriBiDi, 
	  and shaping text in different scripts.

	  https://github.com/HOST-Oman/libraqm 
```

## opt/external-packages/python-babel/Config.in
```kconfig
config BR2_PACKAGE_PYTHON_BABEL
	bool "python-babel"
	help
      Babel is a Python library that provides an integrated collection of utilities that assist with internationalizing and localizing Python applications (in particular web-based applications.)


	  https://github.com/python-babel/babel
    
```

## opt/external-packages/python-picamera/Config.in
```kconfig
config BR2_PACKAGE_PYTHON_PICAMERA
	bool "python-picamera"
	help
      This package provides a pure Python interface to the Raspberry Pi camera module for Python 2.7 (or above) or Python 3.2 (or above).

	  https://pypi.org/project/picamera/
    
```

## opt/external-packages/python-pyzbar/Config.in
```kconfig
config BR2_PACKAGE_PYTHON_PYZBAR
	bool "python-pyzbar"
	help
        Read one-dimensional barcodes and QR codes from Python 2 and 3. 
        pyzbar fork with additions/modifications for compatibility with SeedSigner software.


	  https://github.com/SeedSigner/pyzbar
    
```

## opt/external-packages/secp256k1/Config.in
```kconfig
config BR2_PACKAGE_SECP256K1
    bool "secp256k1"
    help
      This package provides the secp256k1 cryptographic library
      from the Bitcoin Core project.

      https://github.com/bitcoin-core/secp256k1
```

## opt/pi0/Config.in
```kconfig
source "../external-packages/python-urtypes/Config.in"
source "../external-packages/python-pyzbar/Config.in"
source "../external-packages/python-mock/Config.in"
source "../external-packages/python-embit/Config.in"
source "../external-packages/python-picamera/Config.in"
source "../external-packages/python-pillow-ep/Config.in"
source "../external-packages/libraqm/Config.in"
```

## opt/pi0/configs/pi0_defconfig
```kconfig
BR2_arm=y
BR2_arm1176jzf_s=y
BR2_DL_DIR="$(TOPDIR)/../../buildroot_dl"
BR2_CCACHE=y
BR2_TOOLCHAIN_BUILDROOT_VENDOR="Buildroot"
BR2_TOOLCHAIN_BUILDROOT_GLIBC=y
BR2_PACKAGE_HOST_LINUX_HEADERS_CUSTOM_5_15=y
BR2_PACKAGE_GLIBC_UTILS=y
BR2_TOOLCHAIN_BUILDROOT_CXX=y
BR2_TARGET_GENERIC_HOSTNAME="seedsigner-os"
BR2_ROOTFS_DEVICE_CREATION_DYNAMIC_MDEV=y
BR2_TARGET_GENERIC_ROOT_PASSWD="passworDT"
BR2_ROOTFS_OVERLAY="../pi0/board/raspberrypi/rootfs-overlay/"
BR2_ROOTFS_POST_BUILD_SCRIPT="../pi0/board/raspberrypi/post-build.sh"
BR2_ROOTFS_POST_IMAGE_SCRIPT="../pi0/board/raspberrypi/post-image-seedsigner.sh"
BR2_LINUX_KERNEL=y
BR2_LINUX_KERNEL_CUSTOM_TARBALL=y
BR2_LINUX_KERNEL_CUSTOM_TARBALL_LOCATION="$(call github,raspberrypi,linux,ea7fe1b21ea73146b1d49ac5f554fbd0ac5de9de)/linux-ea7fe1b21ea73146b1d49ac5f554fbd0ac5de9de.tar.gz"
BR2_LINUX_KERNEL_USE_CUSTOM_CONFIG=y
BR2_LINUX_KERNEL_CUSTOM_CONFIG_FILE="../pi0/board/raspberrypi/kernel.config"
BR2_LINUX_KERNEL_XZ=y
BR2_LINUX_KERNEL_DTS_SUPPORT=y
BR2_LINUX_KERNEL_INTREE_DTS_NAME="bcm2708-rpi-b bcm2708-rpi-b-plus bcm2708-rpi-zero-w bcm2708-rpi-zero bcm2710-rpi-zero-2-w bcm2709-rpi-2-b bcm2710-rpi-3-b bcm2710-rpi-3-b-plus bcm2837-rpi-3-b bcm2711-rpi-4-b"
BR2_PACKAGE_BUSYBOX_CONFIG="../pi0/board/raspberrypi/busybox.config"
BR2_PACKAGE_BUSYBOX_SHOW_OTHERS=y
BR2_PACKAGE_V4L2GRAB=y
BR2_PACKAGE_V4L2LOOPBACK=y
BR2_PACKAGE_RPI_FIRMWARE=y
BR2_PACKAGE_RPI_FIRMWARE_BOOTCODE_BIN=y
BR2_PACKAGE_RPI_FIRMWARE_VARIANT_PI_X=y
BR2_PACKAGE_RPI_FIRMWARE_CONFIG_FILE="../pi0/board/raspberrypi/config_seedsigner.txt"
BR2_PACKAGE_PIGPIO=y
BR2_PACKAGE_RASPI_GPIO=y
BR2_PACKAGE_RPI_USERLAND=y
BR2_PACKAGE_SPI_TOOLS=y
BR2_PACKAGE_NETCAT=y
BR2_PACKAGE_NETCAT_OPENBSD=y
BR2_PACKAGE_PYTHON3=y
BR2_PACKAGE_PYTHON3_SSL=y
BR2_PACKAGE_PYTHON3_XZ=y
BR2_PACKAGE_PYTHON_ASN1CRYPTO=y
BR2_PACKAGE_PYTHON_IDNA=y
BR2_PACKAGE_PYTHON_PIGPIO=y
BR2_PACKAGE_PYTHON_PILLOW=y
BR2_PACKAGE_PYTHON_PYOPENSSL=y
BR2_PACKAGE_PYTHON_PYQRCODE=y
BR2_PACKAGE_PYTHON_PYTEST=y
BR2_PACKAGE_PYTHON_RPI_GPIO=y
BR2_PACKAGE_PYTHON_RSA=y
BR2_PACKAGE_PYTHON_SETUPTOOLS=y
BR2_PACKAGE_PYTHON_SPIDEV=y
BR2_PACKAGE_GNUTLS_OPENSSL=y
BR2_PACKAGE_LIBGPG_ERROR=y
BR2_PACKAGE_LIBOPENSSL_BIN=y
BR2_PACKAGE_LIBOPENSSL_ENGINES=y
BR2_PACKAGE_FONTCONFIG=y
BR2_PACKAGE_LIBFREEIMAGE=y
BR2_PACKAGE_LIBQRENCODE=y
BR2_PACKAGE_LIBQRENCODE_TOOLS=y
BR2_PACKAGE_OPENCV3=y
BR2_PACKAGE_OPENCV3_LIB_PYTHON=y
BR2_PACKAGE_OPENCV3_LIB_VIDEO=y
BR2_PACKAGE_OPENCV3_WITH_JPEG=y
BR2_PACKAGE_OPENCV3_WITH_PNG=y
BR2_PACKAGE_OPENCV3_WITH_V4L=y
BR2_PACKAGE_OPENJPEG=y
BR2_PACKAGE_ZBAR=y
BR2_PACKAGE_BCM2835=y
BR2_PACKAGE_LIBHID=y
BR2_PACKAGE_LIBCAMERA=y
BR2_PACKAGE_LIBCAMERA_V4L2=y
BR2_PACKAGE_LIBCAMERA_PIPELINE_RASPBERRYPI=y
BR2_PACKAGE_LIBCAMERA_PIPELINE_UVCVIDEO=y
BR2_PACKAGE_LIBOPENH264=y
BR2_PACKAGE_X264=y
BR2_PACKAGE_X264_CLI=y
BR2_PACKAGE_X265=y
BR2_PACKAGE_X265_CLI=y
BR2_PACKAGE_HAVEGED=y
BR2_TARGET_ROOTFS_CPIO_XZ=y
BR2_TARGET_ROOTFS_INITRAMFS=y
BR2_PACKAGE_HOST_DOSFSTOOLS=y
BR2_PACKAGE_HOST_E2FSPROGS=y
BR2_PACKAGE_HOST_GENIMAGE=y
BR2_PACKAGE_HOST_MTOOLS=y
BR2_PACKAGE_PYTHON_URTYPES=y
BR2_PACKAGE_PYTHON_PYZBAR=y
BR2_PACKAGE_PYTHON_MOCK=y
BR2_PACKAGE_PYTHON_EMBIT=y
BR2_PACKAGE_PYTHON_PICAMERA=y
BR2_PACKAGE_PYTHON_QRCODE=y
```

## opt/pi0/package/python-pyzbar-ss/Config.in
```kconfig
config BR2_PACKAGE_PYTHON_PYZBAR_SS
	bool "python-pyzbar-ss"
	help
        Read one-dimensional barcodes and QR codes from Python 2 and 3. 
        pyzbar fork with additions/modifications for compatibility with SeedSigner software.


	  https://github.com/SeedSigner/pyzbar
    
```

## opt/pi0X/configs/pi0X_defconfig
```kconfig
BR2_arm=y
BR2_arm1176jzf_s=y
BR2_DL_DIR="$(TOPDIR)/../../buildroot_dl"
BR2_CCACHE=y
BR2_REPRODUCIBLE=y
BR2_TOOLCHAIN_BUILDROOT_VENDOR="Buildroot"
BR2_TOOLCHAIN_BUILDROOT_GLIBC=y
BR2_PACKAGE_HOST_LINUX_HEADERS_CUSTOM_5_15=y
BR2_PACKAGE_GLIBC_UTILS=y
BR2_TOOLCHAIN_BUILDROOT_CXX=y
BR2_TARGET_GENERIC_HOSTNAME="seedsigner-os"
BR2_ROOTFS_DEVICE_CREATION_DYNAMIC_MDEV=y
BR2_TARGET_GENERIC_ROOT_PASSWD="passworDT"
BR2_ROOTFS_OVERLAY="../rootfs-overlay/"
BR2_ROOTFS_POST_BUILD_SCRIPT="../pi0X/board/post-build.sh"
BR2_ROOTFS_POST_IMAGE_SCRIPT="../pi0X/board/post-image-seedsigner.sh"
BR2_LINUX_KERNEL=y
BR2_LINUX_KERNEL_CUSTOM_TARBALL=y
BR2_LINUX_KERNEL_CUSTOM_TARBALL_LOCATION="$(call github,raspberrypi,linux,14b35093ca68bf2c81bbc90aace5007142b40b40)/linux-14b35093ca68bf2c81bbc90aace5007142b40b40.tar.gz"
BR2_LINUX_KERNEL_NEEDS_HOST_OPENSSL=y
BR2_LINUX_KERNEL_USE_CUSTOM_CONFIG=y
BR2_LINUX_KERNEL_CUSTOM_CONFIG_FILE="../pi0X/board/kernel.config"
BR2_LINUX_KERNEL_LZ4=y
BR2_LINUX_KERNEL_DTS_SUPPORT=y
BR2_LINUX_KERNEL_INTREE_DTS_NAME="bcm2708-rpi-b bcm2708-rpi-b-plus bcm2708-rpi-zero-w bcm2708-rpi-zero"
BR2_PACKAGE_BUSYBOX_CONFIG="../pi0X/board/busybox.config"
BR2_PACKAGE_BUSYBOX_SHOW_OTHERS=y
BR2_PACKAGE_RPI_FIRMWARE=y
BR2_PACKAGE_RPI_FIRMWARE_BOOTCODE_BIN=y
BR2_PACKAGE_RPI_FIRMWARE_VARIANT_PI_X=y
BR2_PACKAGE_RPI_FIRMWARE_CONFIG_FILE="../pi0X/board/boot_config.txt"
BR2_PACKAGE_RPI_FIRMWARE_CMDLINE_FILE="../pi0X/board/boot_cmdline.txt"
BR2_PACKAGE_RPI_USERLAND=y
BR2_PACKAGE_SPI_TOOLS=y
BR2_PACKAGE_PYTHON3=y
BR2_PACKAGE_PYTHON_PIGPIO=y
BR2_PACKAGE_PYTHON_PILLOW=y
BR2_PACKAGE_PYTHON_PYQRCODE=y
BR2_PACKAGE_PYTHON_RPI_GPIO=y
BR2_PACKAGE_PYTHON_SPIDEV=y
BR2_PACKAGE_FONTCONFIG=y
BR2_PACKAGE_LIBQRENCODE=y
BR2_PACKAGE_LIBQRENCODE_TOOLS=y
BR2_PACKAGE_PYTHON_NUMPY=y
BR2_PACKAGE_ZBAR=y
BR2_PACKAGE_BCM2835=y
BR2_TARGET_ROOTFS_CPIO_GZIP=y
BR2_TARGET_ROOTFS_INITRAMFS=y
BR2_PACKAGE_HOST_DOSFSTOOLS=y
BR2_PACKAGE_HOST_E2FSPROGS=y
BR2_PACKAGE_HOST_GENIMAGE=y
BR2_PACKAGE_HOST_MTOOLS=y
BR2_PACKAGE_PYTHON_URTYPES=y
BR2_PACKAGE_PYTHON_PYZBAR=y
BR2_PACKAGE_PYTHON_MOCK=y
BR2_PACKAGE_PYTHON_EMBIT=y
BR2_PACKAGE_PYTHON_PICAMERA=y
BR2_PACKAGE_PYTHON_QRCODE=y
```

## rpi-seedsigner-dev/Config.in
```kconfig
    source "$BR2_EXTERNAL_RPI_SEEDSIGNER_DEV_MIN_PATH/package/python-urtypes/Config.in"
    source "$BR2_EXTERNAL_RPI_SEEDSIGNER_DEV_MIN_PATH/package/python-pyzbar/Config.in"
    source "$BR2_EXTERNAL_RPI_SEEDSIGNER_DEV_MIN_PATH/package/python-mock/Config.in"
    source "$BR2_EXTERNAL_RPI_SEEDSIGNER_DEV_MIN_PATH/package/python-embit/Config.in"
    source "$BR2_EXTERNAL_RPI_SEEDSIGNER_DEV_MIN_PATH/package/python-picamera/Config.in"
    source "$BR2_EXTERNAL_RPI_SEEDSIGNER_DEV_MIN_PATH/package/python-qrcode/Config.in" 
```

## rpi-seedsigner-dev/package/python-embit/Config.in
```kconfig
config BR2_PACKAGE_PYTHON_EMBIT
	bool "python-embit"
	help
      yet another bitcoin library

	  https://pypi.org/project/embit
      Yeah SeedSigner!    
```

## rpi-seedsigner-dev/package/python-mock/Config.in
```kconfig
config BR2_PACKAGE_PYTHON_MOCK
	bool "python-mock"
	help
      mock is a library for testing in Python. It allows you to replace parts of your system under test with mock objects and make assertions about how they have been used.

	  https://pypi.org/project/mock/
    
```

## rpi-seedsigner/configs/rpi-seedsigner_defconfig
```kconfig
BR2_arm=y
BR2_arm1176jzf_s=y
BR2_DL_DIR="$(TOPDIR)/../buildroot_dl"
BR2_CCACHE=y
BR2_TOOLCHAIN_BUILDROOT_VENDOR="Buildroot"
BR2_TOOLCHAIN_BUILDROOT_GLIBC=y
BR2_PACKAGE_HOST_LINUX_HEADERS_CUSTOM_5_15=y
BR2_PACKAGE_GLIBC_UTILS=y
BR2_TOOLCHAIN_BUILDROOT_CXX=y
BR2_TARGET_GENERIC_HOSTNAME="Seedsigner"
BR2_TARGET_GENERIC_ISSUE="Welcome to SeedSigner RAM"
BR2_ROOTFS_DEVICE_CREATION_DYNAMIC_MDEV=y
BR2_TARGET_GENERIC_ROOT_PASSWD="passworDT"
# BR2_TARGET_GENERIC_GETTY is not set
# BR2_TARGET_GENERIC_REMOUNT_ROOTFS_RW is not set
BR2_ROOTFS_OVERLAY="../rpi-seedsigner/board/raspberrypi/rootfs-overlay/"
BR2_ROOTFS_POST_BUILD_SCRIPT="../rpi-seedsigner/board/raspberrypi/post-build.sh"
BR2_ROOTFS_POST_IMAGE_SCRIPT="../rpi-seedsigner/board/raspberrypi/post-image-seedsigner.sh"
BR2_LINUX_KERNEL=y
BR2_LINUX_KERNEL_CUSTOM_TARBALL=y
BR2_LINUX_KERNEL_CUSTOM_TARBALL_LOCATION="$(call github,raspberrypi,linux,ea7fe1b21ea73146b1d49ac5f554fbd0ac5de9de)/linux-ea7fe1b21ea73146b1d49ac5f554fbd0ac5de9de.tar.gz"
BR2_LINUX_KERNEL_USE_CUSTOM_CONFIG=y
BR2_LINUX_KERNEL_CUSTOM_CONFIG_FILE="../rpi-seedsigner/board/raspberrypi/kernel.config"
BR2_LINUX_KERNEL_XZ=y
BR2_LINUX_KERNEL_DTS_SUPPORT=y
BR2_LINUX_KERNEL_INTREE_DTS_NAME="bcm2708-rpi-zero-w bcm2708-rpi-zero bcm2710-rpi-3-b bcm2710-rpi-3-b-plus bcm2710-rpi-cm3"
BR2_PACKAGE_BUSYBOX_CONFIG="../rpi-seedsigner/board/raspberrypi/busybox.config"
BR2_PACKAGE_V4L2GRAB=y
BR2_PACKAGE_V4L2LOOPBACK=y
BR2_PACKAGE_RPI_FIRMWARE=y
BR2_PACKAGE_RPI_FIRMWARE_BOOTCODE_BIN=y
BR2_PACKAGE_RPI_FIRMWARE_VARIANT_PI_X=y
BR2_PACKAGE_RPI_FIRMWARE_CONFIG_FILE="../rpi-seedsigner/board/raspberrypi/config_seedsigner.txt"
BR2_PACKAGE_PIGPIO=y
BR2_PACKAGE_RASPI_GPIO=y
BR2_PACKAGE_RPI_USERLAND=y
BR2_PACKAGE_SPI_TOOLS=y
BR2_PACKAGE_PYTHON3=y
BR2_PACKAGE_PYTHON3_SSL=y
BR2_PACKAGE_PYTHON3_XZ=y
BR2_PACKAGE_PYTHON_ASN1CRYPTO=y
BR2_PACKAGE_PYTHON_IDNA=y
BR2_PACKAGE_PYTHON_PIGPIO=y
BR2_PACKAGE_PYTHON_PILLOW=y
BR2_PACKAGE_PYTHON_PYOPENSSL=y
BR2_PACKAGE_PYTHON_PYQRCODE=y
BR2_PACKAGE_PYTHON_PYTEST=y
BR2_PACKAGE_PYTHON_RPI_GPIO=y
BR2_PACKAGE_PYTHON_RSA=y
BR2_PACKAGE_PYTHON_SETUPTOOLS=y
BR2_PACKAGE_PYTHON_SPIDEV=y
BR2_PACKAGE_GNUTLS_OPENSSL=y
BR2_PACKAGE_LIBGPG_ERROR=y
BR2_PACKAGE_LIBOPENSSL_BIN=y
BR2_PACKAGE_LIBOPENSSL_ENGINES=y
# BR2_PACKAGE_LIBOPENSSL_ENABLE_RC5 is not set
# BR2_PACKAGE_LIBOPENSSL_ENABLE_RC2 is not set
# BR2_PACKAGE_LIBOPENSSL_ENABLE_RC4 is not set
# BR2_PACKAGE_LIBOPENSSL_ENABLE_MD2 is not set
# BR2_PACKAGE_LIBOPENSSL_ENABLE_MD4 is not set
# BR2_PACKAGE_LIBOPENSSL_ENABLE_IDEA is not set
# BR2_PACKAGE_LIBOPENSSL_ENABLE_DES is not set
# BR2_PACKAGE_LIBOPENSSL_ENABLE_SSL is not set
# BR2_PACKAGE_LIBOPENSSL_ENABLE_SSL2 is not set
# BR2_PACKAGE_LIBOPENSSL_ENABLE_SSL3 is not set
# BR2_PACKAGE_LIBOPENSSL_ENABLE_WEAK_SSL is not set
# BR2_PACKAGE_LIBOPENSSL_ENABLE_PSK is not set
# BR2_PACKAGE_LIBOPENSSL_ENABLE_CAST is not set
# BR2_PACKAGE_LIBOPENSSL_UNSECURE is not set
BR2_PACKAGE_FONTCONFIG=y
BR2_PACKAGE_LIBFREEIMAGE=y
BR2_PACKAGE_LIBQRENCODE=y
BR2_PACKAGE_LIBQRENCODE_TOOLS=y
BR2_PACKAGE_OPENCV3=y
BR2_PACKAGE_OPENCV3_LIB_PYTHON=y
BR2_PACKAGE_OPENCV3_LIB_VIDEO=y
BR2_PACKAGE_OPENCV3_WITH_GSTREAMER1=y
BR2_PACKAGE_OPENCV3_WITH_JPEG=y
BR2_PACKAGE_OPENCV3_WITH_PNG=y
BR2_PACKAGE_OPENCV3_WITH_V4L=y
BR2_PACKAGE_OPENJPEG=y
BR2_PACKAGE_ZBAR=y
BR2_PACKAGE_BCM2835=y
BR2_PACKAGE_LIBHID=y
BR2_PACKAGE_LIBCAMERA=y
BR2_PACKAGE_LIBCAMERA_V4L2=y
BR2_PACKAGE_LIBCAMERA_PIPELINE_RASPBERRYPI=y
BR2_PACKAGE_LIBCAMERA_PIPELINE_UVCVIDEO=y
BR2_PACKAGE_LIBOPENH264=y
BR2_PACKAGE_X264=y
BR2_PACKAGE_X264_CLI=y
BR2_PACKAGE_X265=y
BR2_PACKAGE_X265_CLI=y
BR2_PACKAGE_HAVEGED=y
# BR2_PACKAGE_IFUPDOWN_SCRIPTS is not set
# BR2_PACKAGE_URANDOM_SCRIPTS is not set
BR2_TARGET_ROOTFS_CPIO_XZ=y
BR2_TARGET_ROOTFS_INITRAMFS=y
# BR2_TARGET_ROOTFS_TAR is not set
BR2_PACKAGE_HOST_DOSFSTOOLS=y
BR2_PACKAGE_HOST_E2FSPROGS=y
BR2_PACKAGE_HOST_GENIMAGE=y
BR2_PACKAGE_HOST_MTOOLS=y
BR2_PACKAGE_PYTHON_URTYPES=y
BR2_PACKAGE_PYTHON_PYZBAR=y
BR2_PACKAGE_PYTHON_MOCK=y
BR2_PACKAGE_PYTHON_EMBIT=y
BR2_PACKAGE_PYTHON_PICAMERA=y
BR2_PACKAGE_PYTHON_QRCODE=y
```

## rpi-seedsigner/package/python-qrcode/Config.in
```kconfig
config BR2_PACKAGE_PYTHON_QRCODE
	bool "python-qrcode"
	help
      Generate QR codes.

	  https://pypi.org/project/qrcode/
    
```
